/dts-v1/;

#include "ar2313.dtsi"

/ {
	model = "Netgear WG102";
	compatible = "netgear,wg102", "qca,ar2313";

	memory@0 {
		device_type = "memory";
		reg = <0x0 0x1000000>;
	};

	chosen {
		stdout-path = &uart0;
	};
};

&uart0 {
	status = "okay";
	clock-frequency = <40000000>;
};
