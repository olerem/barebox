/ {
	ahb {
		mac0: mac@19000000 {
			compatible = "qca,ar7100-gmac", "qca,ar9331-gmac";
			reg = <0x18070000 0x00000100>,
			      <0x19000000 0x01000000>;
			reg-names = "gmac", "ge0";
			phy-mode = "mii";
			status = "disabled";
               };
	};
};
