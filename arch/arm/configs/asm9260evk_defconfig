## arch/arm/mach-alphascale/Kconfig
```kconfig
if ARCH_ALPHASCALE

config ARCH_TEXT_BASE
	hex
	default 0x21000000 if SOC_ALPHASCALE_ASM9260

comment "Alphascale ARM926ejs System-on-Chip"

choice
	prompt "Alphascale ARM926ejs Processors"

config SOC_ALPHASCALE_ASM9260
	bool "Alphascale ASM9260"
	select CPU_ARM926T

endchoice

endif


# ----------------------------------------------------------

if SOC_ALPHASCALE_ASM9260

choice
	prompt "ASM9260 Board Type"

config MACH_ASM9260_DEVKIT
	bool "Alphascale ASM9260 Evaluation Kit"
	help
	  Select this if you are using Alphascale's ASM9260 Evaluation Kit.
	  <http://www.alphascale.com>

endchoice

endif
# ----------------------------------------------------------
```

## arch/mips/mach-ar231x/Kconfig
```kconfig
if MACH_MIPS_AR231X

config ARCH_TEXT_BASE
	hex
	default 0xa0800000

choice
	prompt "Board type"

config BOARD_NETGEAR_WG102
	bool "Netgear WG102"
	select HAVE_PBL_IMAGE
	select HAVE_IMAGE_COMPRESSION

endchoice

if DEBUG_LL
choice
	prompt "DEBUG_LL port"

config AR231X_DEBUG_LL_UART0
	bool "AR2312 - UART0"

config AR231X_DEBUG_LL_UART1
	bool "AR2315 - UART1"

endchoice
endif # DEBUG_LL


endif
```

## arch/mips/mach-ar5523/Kconfig
```kconfig
if MACH_MIPS_AR5523

config STACK_BASE
	hex
	default 0x80000000

config STACK_SIZE
	hex
	default 0x4000

config MALLOC_BASE
	hex
	default 0x80004000

config MALLOC_SIZE
	hex
	default 0xc000

config ARCH_TEXT_BASE
	hex
	default 0x80010000

choice
	prompt "Board type"

config BOARD_ATHEROS_REF
	bool "Atheros reference design"

endchoice

endif
```

## arch/mips/mach-ath79/Kconfig
```kconfig
if MACH_MIPS_ATH79

config ARCH_TEXT_BASE
	hex
	default 0xa0800000

config SOC_QCA_AR9331
	bool

config SOC_QCA_AR9344
	bool

config MIPS_ATH79_MULTI_BOARDS
	bool "Allow multiple boards to be selected"
	select HAVE_PBL_MULTI_IMAGES

if MIPS_ATH79_MULTI_BOARDS

config BOARD_8DEVICES_LIMA
	bool "8devices LIMA"
	select SOC_QCA_QCA4531
	select HAVE_PBL_IMAGE
	select HAVE_IMAGE_COMPRESSION
	select HAS_NMON

config BOARD_DPTECHNICS_DPT_MODULE
	bool "DPTechnics DPT-Module"
	select SOC_QCA_AR9331
	select HAVE_PBL_IMAGE
	select HAVE_IMAGE_COMPRESSION
	select HAS_NMON

config BOARD_TPLINK_MR3020
	bool "TP-LINK MR3020"
	select SOC_QCA_AR9331
	select HAVE_PBL_IMAGE
	select HAVE_IMAGE_COMPRESSION
	select HAS_NMON

config BOARD_TPLINK_WDR4300
	bool "TP-LINK WDR4300"
	select SOC_QCA_AR9344
	select HAVE_PBL_IMAGE
	select HAVE_IMAGE_COMPRESSION
	select HAS_NMON

config BOARD_BLACK_SWIFT
	bool "Black Swift"
	select SOC_QCA_AR9331
	select HAVE_PBL_IMAGE
	select HAVE_IMAGE_COMPRESSION
	select HAS_NMON

endif # MIPS_ATH79_MULTI_BOARDS

endif
```

## arch/mips/mach-mediatek/Kconfig
```kconfig
if MACH_MIPS_MEDIATEK

config ARCH_TEXT_BASE
	hex
	default 0xa0800000

config SOC_MEDIATEK_MT7688
	bool

choice
	prompt "Board type"

config BOARD_SEEED_STUDIO_LINKIT_SMART_7688
	bool "Seeed Studio - LinkIt Smart 7688"
	select SOC_MEDIATEK_MT7688
	select HAVE_PBL_IMAGE
	select HAVE_IMAGE_COMPRESSION
	select HAS_NMON
	select HAS_NO_BOARD_HL_CODE

endchoice

endif
```
